/**
 * LoRa Node Host Application
 * Win32 API + Serial Communication
 * 
 * 编译方法 (MinGW):
 *   g++ -o lora_host.exe main.cpp -mwindows -lcomctl32
 * 
 * 编译方法 (MSVC):
 *   cl /EHsc main.cpp user32.lib gdi32.lib comctl32.lib
 */

#define UNICODE
#define _UNICODE
#define WIN32_LEAN_AND_MEAN

#include <windows.h>
#include <commctrl.h>
#include <stdio.h>
#include <stdlib.h>
#include <string.h>
#include <stdint.h>

#pragma comment(lib, "comctl32.lib")

// ======================== Protocol Constants ========================

#define UART_START_BYTE     0xAA
#define UART_CMD_CONNECT    0x01
#define UART_CMD_DISCONNECT 0x02
#define UART_CMD_SEND       0x03
#define UART_CMD_RECEIVE    0x04
#define UART_CMD_SET_PARAM  0x05
#define UART_CMD_GET_PARAM  0x06
#define UART_CMD_GET_HISTORY 0x07
#define UART_CMD_ACK        0x08
#define UART_CMD_NACK       0x09

#define PARAM_FREQUENCY     0x01
#define PARAM_TX_POWER      0x02
#define PARAM_SF            0x03
#define PARAM_BW            0x04
#define PARAM_CR            0x05
#define PARAM_SYNC_WORD     0x06

// ======================== Window Controls ========================

#define ID_COMBO_PORT       101
#define ID_BTN_REFRESH      102
#define ID_BTN_CONNECT      103
#define ID_BTN_DISCONNECT   104
#define ID_EDIT_SEND        105
#define ID_BTN_SEND         106
#define ID_LIST_RECV        107
#define ID_BTN_CLEAR        108
#define ID_EDIT_FREQ        109
#define ID_EDIT_POWER       110
#define ID_EDIT_SF          111
#define ID_COMBO_BW         112
#define ID_COMBO_CR         113
#define ID_BTN_SET_PARAMS   114
#define ID_BTN_GET_PARAMS   115
#define ID_BTN_GET_HISTORY  116
#define ID_STATIC_STATUS    117
#define ID_TIMER_RECV       1

// ======================== Global Variables ========================

HWND g_hWnd = NULL;
HWND g_hComboPort = NULL;
HWND g_hBtnConnect = NULL;
HWND g_hBtnDisconnect = NULL;
HWND g_hEditSend = NULL;
HWND g_hListRecv = NULL;
HWND g_hEditFreq = NULL;
HWND g_hEditPower = NULL;
HWND g_hEditSF = NULL;
HWND g_hComboBW = NULL;
HWND g_hComboCR = NULL;
HWND g_hStaticStatus = NULL;

HANDLE g_hSerial = INVALID_HANDLE_VALUE;
bool g_bConnected = false;

// Receive buffer and parser state
uint8_t g_rxBuffer[512];
int g_rxIndex = 0;

enum ParserState {
    WAIT_START,
    WAIT_CMD,
    WAIT_LEN,
    WAIT_DATA,
    WAIT_CHECKSUM
};

ParserState g_parserState = WAIT_START;
uint8_t g_rxCmd = 0;
uint8_t g_rxLen = 0;
uint8_t g_rxDataIndex = 0;
uint8_t g_rxData[256];
uint8_t g_rxChecksum = 0;

// Bandwidth strings
const wchar_t* BW_Strings[] = {
    L"7.81 kHz", L"10.42 kHz", L"15.63 kHz", L"20.83 kHz", L"31.25 kHz",
    L"41.67 kHz", L"62.5 kHz", L"125 kHz", L"250 kHz", L"500 kHz"
};

// ======================== Function Declarations ========================

LRESULT CALLBACK WndProc(HWND, UINT, WPARAM, LPARAM);
void CreateControls(HWND hWnd);
void RefreshPorts();
bool OpenSerialPort(const wchar_t* portName);
void CloseSerialPort();
void SendPacket(uint8_t cmd, uint8_t* data, uint8_t len);
void ProcessReceivedByte(uint8_t byte);
void ProcessPacket();
void ReadSerialData();
void AddLogMessage(const wchar_t* msg);
void AddLogMessageA(const char* msg);
void UpdateStatus(const wchar_t* status);
void SendConnect();
void SendDisconnect();
void SendLoRaMessage();
void SetLoRaParams();
void GetLoRaParams();
void GetHistory();

// ======================== Main Entry ========================

int WINAPI wWinMain(HINSTANCE hInstance, HINSTANCE hPrevInstance, 
                    LPWSTR lpCmdLine, int nCmdShow)
{
    // Initialize common controls
    INITCOMMONCONTROLSEX icex;
    icex.dwSize = sizeof(INITCOMMONCONTROLSEX);
    icex.dwICC = ICC_WIN95_CLASSES;
    InitCommonControlsEx(&icex);

    // Register window class
    WNDCLASSEX wc = {0};
    wc.cbSize = sizeof(WNDCLASSEX);
    wc.style = CS_HREDRAW | CS_VREDRAW;
    wc.lpfnWndProc = WndProc;
    wc.hInstance = hInstance;
    wc.hCursor = LoadCursor(NULL, IDC_ARROW);
    wc.hbrBackground = (HBRUSH)(COLOR_BTNFACE + 1);
    wc.lpszClassName = L"LoRaHostClass";
    wc.hIcon = LoadIcon(NULL, IDI_APPLICATION);
    
    if (!RegisterClassEx(&wc)) {
        MessageBox(NULL, L"Window Registration Failed!", L"Error", MB_ICONERROR);
        return 0;
    }

    // Create main window
    g_hWnd = CreateWindowEx(
        0,
        L"LoRaHostClass",
        L"LoRa Node Host - Disconnected",
        WS_OVERLAPPEDWINDOW & ~WS_THICKFRAME & ~WS_MAXIMIZEBOX,
        CW_USEDEFAULT, CW_USEDEFAULT, 700, 580,
        NULL, NULL, hInstance, NULL
    );

    if (!g_hWnd) {
        MessageBox(NULL, L"Window Creation Failed!", L"Error", MB_ICONERROR);
        return 0;
    }

    ShowWindow(g_hWnd, nCmdShow);
    UpdateWindow(g_hWnd);

    // Message loop
    MSG msg;
    while (GetMessage(&msg, NULL, 0, 0)) {
        TranslateMessage(&msg);
        DispatchMessage(&msg);
    }

    return (int)msg.wParam;
}

// ======================== Window Procedure ========================

LRESULT CALLBACK WndProc(HWND hWnd, UINT message, WPARAM wParam, LPARAM lParam)
{
    switch (message) {
    case WM_CREATE:
        CreateControls(hWnd);
        RefreshPorts();
        SetTimer(hWnd, ID_TIMER_RECV, 50, NULL);  // 50ms polling
        return 0;

    case WM_TIMER:
        if (wParam == ID_TIMER_RECV && g_hSerial != INVALID_HANDLE_VALUE) {
            ReadSerialData();
        }
        return 0;

    case WM_COMMAND:
        switch (LOWORD(wParam)) {
        case ID_BTN_REFRESH:
            RefreshPorts();
            break;
        case ID_BTN_CONNECT:
            SendConnect();
            break;
        case ID_BTN_DISCONNECT:
            SendDisconnect();
            break;
        case ID_BTN_SEND:
            SendLoRaMessage();
            break;
        case ID_BTN_CLEAR:
            SendMessage(g_hListRecv, LB_RESETCONTENT, 0, 0);
            break;
        case ID_BTN_SET_PARAMS:
            SetLoRaParams();
            break;
        case ID_BTN_GET_PARAMS:
            GetLoRaParams();
            break;
        case ID_BTN_GET_HISTORY:
            GetHistory();
            break;
        }
        return 0;

    case WM_DESTROY:
        KillTimer(hWnd, ID_TIMER_RECV);
        CloseSerialPort();
        PostQuitMessage(0);
        return 0;

    default:
        return DefWindowProc(hWnd, message, wParam, lParam);
    }
}

// ======================== UI Creation ========================

void CreateControls(HWND hWnd)
{
    HFONT hFont = CreateFont(14, 0, 0, 0, FW_NORMAL, FALSE, FALSE, FALSE,
        DEFAULT_CHARSET, OUT_DEFAULT_PRECIS, CLIP_DEFAULT_PRECIS,
        CLEARTYPE_QUALITY, DEFAULT_PITCH | FF_DONTCARE, L"Segoe UI");

    int y = 10;

    // ---- Serial Port Section ----
    CreateWindow(L"STATIC", L"Serial Port:", WS_CHILD | WS_VISIBLE,
        10, y + 3, 80, 20, hWnd, NULL, NULL, NULL);

    g_hComboPort = CreateWindow(L"COMBOBOX", NULL,
        WS_CHILD | WS_VISIBLE | CBS_DROPDOWNLIST | WS_VSCROLL,
        95, y, 100, 200, hWnd, (HMENU)ID_COMBO_PORT, NULL, NULL);

    CreateWindow(L"BUTTON", L"Refresh",
        WS_CHILD | WS_VISIBLE | BS_PUSHBUTTON,
        200, y, 70, 25, hWnd, (HMENU)ID_BTN_REFRESH, NULL, NULL);

    g_hBtnConnect = CreateWindow(L"BUTTON", L"Connect",
        WS_CHILD | WS_VISIBLE | BS_PUSHBUTTON,
        280, y, 80, 25, hWnd, (HMENU)ID_BTN_CONNECT, NULL, NULL);

    g_hBtnDisconnect = CreateWindow(L"BUTTON", L"Disconnect",
        WS_CHILD | WS_VISIBLE | BS_PUSHBUTTON | WS_DISABLED,
        365, y, 90, 25, hWnd, (HMENU)ID_BTN_DISCONNECT, NULL, NULL);

    y += 35;

    // ---- Send Message Section ----
    CreateWindow(L"STATIC", L"Send Message:", WS_CHILD | WS_VISIBLE,
        10, y + 3, 100, 20, hWnd, NULL, NULL, NULL);

    g_hEditSend = CreateWindowEx(WS_EX_CLIENTEDGE, L"EDIT", L"",
        WS_CHILD | WS_VISIBLE | ES_AUTOHSCROLL,
        115, y, 450, 24, hWnd, (HMENU)ID_EDIT_SEND, NULL, NULL);

    CreateWindow(L"BUTTON", L"Send",
        WS_CHILD | WS_VISIBLE | BS_PUSHBUTTON,
        575, y, 100, 25, hWnd, (HMENU)ID_BTN_SEND, NULL, NULL);

    y += 35;

    // ---- Received Messages Section ----
    CreateWindow(L"STATIC", L"Received Messages:", WS_CHILD | WS_VISIBLE,
        10, y, 150, 20, hWnd, NULL, NULL, NULL);

    CreateWindow(L"BUTTON", L"Clear",
        WS_CHILD | WS_VISIBLE | BS_PUSHBUTTON,
        575, y - 3, 100, 23, hWnd, (HMENU)ID_BTN_CLEAR, NULL, NULL);

    y += 22;

    g_hListRecv = CreateWindowEx(WS_EX_CLIENTEDGE, L"LISTBOX", NULL,
        WS_CHILD | WS_VISIBLE | WS_VSCROLL | WS_HSCROLL | LBS_NOINTEGRALHEIGHT,
        10, y, 665, 200, hWnd, (HMENU)ID_LIST_RECV, NULL, NULL);
    SendMessage(g_hListRecv, LB_SETHORIZONTALEXTENT, 1500, 0);

    y += 210;

    // ---- Parameters Section ----
    CreateWindow(L"STATIC", L"LoRa Parameters", WS_CHILD | WS_VISIBLE,
        10, y, 200, 20, hWnd, NULL, NULL, NULL);

    y += 25;

    // Frequency
    CreateWindow(L"STATIC", L"Frequency (Hz):", WS_CHILD | WS_VISIBLE,
        10, y + 3, 100, 20, hWnd, NULL, NULL, NULL);
    g_hEditFreq = CreateWindowEx(WS_EX_CLIENTEDGE, L"EDIT", L"433125000",
        WS_CHILD | WS_VISIBLE | ES_NUMBER,
        115, y, 120, 24, hWnd, (HMENU)ID_EDIT_FREQ, NULL, NULL);

    // TX Power
    CreateWindow(L"STATIC", L"TX Power (dBm):", WS_CHILD | WS_VISIBLE,
        250, y + 3, 110, 20, hWnd, NULL, NULL, NULL);
    g_hEditPower = CreateWindowEx(WS_EX_CLIENTEDGE, L"EDIT", L"22",
        WS_CHILD | WS_VISIBLE | ES_NUMBER,
        365, y, 50, 24, hWnd, (HMENU)ID_EDIT_POWER, NULL, NULL);

    // SF
    CreateWindow(L"STATIC", L"SF:", WS_CHILD | WS_VISIBLE,
        430, y + 3, 30, 20, hWnd, NULL, NULL, NULL);
    g_hEditSF = CreateWindowEx(WS_EX_CLIENTEDGE, L"EDIT", L"11",
        WS_CHILD | WS_VISIBLE | ES_NUMBER,
        460, y, 40, 24, hWnd, (HMENU)ID_EDIT_SF, NULL, NULL);

    y += 32;

    // Bandwidth
    CreateWindow(L"STATIC", L"Bandwidth:", WS_CHILD | WS_VISIBLE,
        10, y + 3, 80, 20, hWnd, NULL, NULL, NULL);
    g_hComboBW = CreateWindow(L"COMBOBOX", NULL,
        WS_CHILD | WS_VISIBLE | CBS_DROPDOWNLIST,
        95, y, 120, 200, hWnd, (HMENU)ID_COMBO_BW, NULL, NULL);
    for (int i = 0; i < 10; i++) {
        SendMessage(g_hComboBW, CB_ADDSTRING, 0, (LPARAM)BW_Strings[i]);
    }
    SendMessage(g_hComboBW, CB_SETCURSEL, 9, 0);  // Default 500kHz

    // Coding Rate
    CreateWindow(L"STATIC", L"Coding Rate:", WS_CHILD | WS_VISIBLE,
        250, y + 3, 90, 20, hWnd, NULL, NULL, NULL);
    g_hComboCR = CreateWindow(L"COMBOBOX", NULL,
        WS_CHILD | WS_VISIBLE | CBS_DROPDOWNLIST,
        345, y, 80, 200, hWnd, (HMENU)ID_COMBO_CR, NULL, NULL);
    SendMessage(g_hComboCR, CB_ADDSTRING, 0, (LPARAM)L"4/5");
    SendMessage(g_hComboCR, CB_ADDSTRING, 0, (LPARAM)L"4/6");
    SendMessage(g_hComboCR, CB_ADDSTRING, 0, (LPARAM)L"4/7");
    SendMessage(g_hComboCR, CB_ADDSTRING, 0, (LPARAM)L"4/8");
    SendMessage(g_hComboCR, CB_SETCURSEL, 0, 0);  // Default 4/5

    y += 32;

    // Buttons
    CreateWindow(L"BUTTON", L"Set Parameters",
        WS_CHILD | WS_VISIBLE | BS_PUSHBUTTON,
        10, y, 120, 28, hWnd, (HMENU)ID_BTN_SET_PARAMS, NULL, NULL);

    CreateWindow(L"BUTTON", L"Get Parameters",
        WS_CHILD | WS_VISIBLE | BS_PUSHBUTTON,
        140, y, 120, 28, hWnd, (HMENU)ID_BTN_GET_PARAMS, NULL, NULL);

    CreateWindow(L"BUTTON", L"Get History",
        WS_CHILD | WS_VISIBLE | BS_PUSHBUTTON,
        270, y, 110, 28, hWnd, (HMENU)ID_BTN_GET_HISTORY, NULL, NULL);

    y += 40;

    // Status bar
    g_hStaticStatus = CreateWindow(L"STATIC", L"Status: Ready",
        WS_CHILD | WS_VISIBLE | SS_SUNKEN,
        10, y, 665, 22, hWnd, (HMENU)ID_STATIC_STATUS, NULL, NULL);

    // Apply font to all controls
    EnumChildWindows(hWnd, [](HWND hwnd, LPARAM lParam) -> BOOL {
        SendMessage(hwnd, WM_SETFONT, lParam, TRUE);
        return TRUE;
    }, (LPARAM)hFont);
}

// ======================== Serial Port Functions ========================

void RefreshPorts()
{
    SendMessage(g_hComboPort, CB_RESETCONTENT, 0, 0);

    wchar_t portName[20];
    for (int i = 1; i <= 256; i++) {
        swprintf(portName, 20, L"COM%d", i);
        
        HANDLE hTest = CreateFile(portName, GENERIC_READ | GENERIC_WRITE,
            0, NULL, OPEN_EXISTING, 0, NULL);
        
        if (hTest != INVALID_HANDLE_VALUE) {
            CloseHandle(hTest);
            SendMessage(g_hComboPort, CB_ADDSTRING, 0, (LPARAM)portName);
        }
    }

    if (SendMessage(g_hComboPort, CB_GETCOUNT, 0, 0) > 0) {
        SendMessage(g_hComboPort, CB_SETCURSEL, 0, 0);
    }
}

bool OpenSerialPort(const wchar_t* portName)
{
    wchar_t fullName[32];
    swprintf(fullName, 32, L"\\\\.\\%s", portName);

    g_hSerial = CreateFile(fullName, GENERIC_READ | GENERIC_WRITE,
        0, NULL, OPEN_EXISTING, 0, NULL);

    if (g_hSerial == INVALID_HANDLE_VALUE) {
        return false;
    }

    // Configure serial port
    DCB dcb = {0};
    dcb.DCBlength = sizeof(DCB);
    
    if (!GetCommState(g_hSerial, &dcb)) {
        CloseHandle(g_hSerial);
        g_hSerial = INVALID_HANDLE_VALUE;
        return false;
    }

    dcb.BaudRate = CBR_115200;
    dcb.ByteSize = 8;
    dcb.StopBits = ONESTOPBIT;
    dcb.Parity = NOPARITY;
    dcb.fBinary = TRUE;
    dcb.fDtrControl = DTR_CONTROL_ENABLE;
    dcb.fRtsControl = RTS_CONTROL_ENABLE;

    if (!SetCommState(g_hSerial, &dcb)) {
        CloseHandle(g_hSerial);
        g_hSerial = INVALID_HANDLE_VALUE;
        return false;
    }

    // Set timeouts
    COMMTIMEOUTS timeouts = {0};
    timeouts.ReadIntervalTimeout = 10;
    timeouts.ReadTotalTimeoutConstant = 10;
    timeouts.ReadTotalTimeoutMultiplier = 0;
    timeouts.WriteTotalTimeoutConstant = 100;
    timeouts.WriteTotalTimeoutMultiplier = 10;
    SetCommTimeouts(g_hSerial, &timeouts);

    // Clear buffers
    PurgeComm(g_hSerial, PURGE_RXCLEAR | PURGE_TXCLEAR);

    return true;
}

void CloseSerialPort()
{
    if (g_hSerial != INVALID_HANDLE_VALUE) {
        CloseHandle(g_hSerial);
        g_hSerial = INVALID_HANDLE_VALUE;
    }
    g_bConnected = false;
    g_parserState = WAIT_START;
}

// ======================== Protocol Functions ========================

void SendPacket(uint8_t cmd, uint8_t* data, uint8_t len)
{
    if (g_hSerial == INVALID_HANDLE_VALUE) return;

    uint8_t buffer[260];
    int idx = 0;

    buffer[idx++] = UART_START_BYTE;
    buffer[idx++] = cmd;
    buffer[idx++] = len;

    uint8_t checksum = cmd ^ len;
    for (int i = 0; i < len; i++) {
        buffer[idx++] = data[i];
        checksum ^= data[i];
    }
    buffer[idx++] = checksum;

    DWORD written;
    WriteFile(g_hSerial, buffer, idx, &written, NULL);

    // Log sent packet
    wchar_t logMsg[512];
    swprintf(logMsg, 512, L"[TX] CMD=0x%02X LEN=%d", cmd, len);
    AddLogMessage(logMsg);
}

void ProcessReceivedByte(uint8_t byte)
{
    switch (g_parserState) {
    case WAIT_START:
        if (byte == UART_START_BYTE) {
            g_parserState = WAIT_CMD;
            g_rxChecksum = 0;
        }
        break;

    case WAIT_CMD:
        g_rxCmd = byte;
        g_rxChecksum ^= byte;
        g_parserState = WAIT_LEN;
        break;

    case WAIT_LEN:
        g_rxLen = byte;
        g_rxChecksum ^= byte;
        g_rxDataIndex = 0;
        if (g_rxLen == 0) {
            g_parserState = WAIT_CHECKSUM;
        } else {
            g_parserState = WAIT_DATA;
        }
        break;

    case WAIT_DATA:
        g_rxData[g_rxDataIndex++] = byte;
        g_rxChecksum ^= byte;
        if (g_rxDataIndex >= g_rxLen) {
            g_parserState = WAIT_CHECKSUM;
        }
        break;

    case WAIT_CHECKSUM:
        if (byte == g_rxChecksum) {
            ProcessPacket();
        } else {
            AddLogMessage(L"[ERR] Checksum mismatch");
        }
        g_parserState = WAIT_START;
        break;
    }
}

void ProcessPacket()
{
    wchar_t logMsg[512];

    switch (g_rxCmd) {
    case UART_CMD_ACK:
        if (g_rxLen >= 1) {
            swprintf(logMsg, 512, L"[ACK] for CMD=0x%02X", g_rxData[0]);
            AddLogMessage(logMsg);

            if (g_rxData[0] == UART_CMD_CONNECT) {
                g_bConnected = true;
                EnableWindow(g_hBtnConnect, FALSE);
                EnableWindow(g_hBtnDisconnect, TRUE);
                SetWindowText(g_hWnd, L"LoRa Node Host - Connected");
                UpdateStatus(L"Status: Connected to device");
            }
            else if (g_rxData[0] == UART_CMD_DISCONNECT) {
                g_bConnected = false;
                EnableWindow(g_hBtnConnect, TRUE);
                EnableWindow(g_hBtnDisconnect, FALSE);
                SetWindowText(g_hWnd, L"LoRa Node Host - Disconnected");
                UpdateStatus(L"Status: Disconnected");
            }
        }
        break;

    case UART_CMD_NACK:
        if (g_rxLen >= 2) {
            swprintf(logMsg, 512, L"[NACK] for CMD=0x%02X, Error=0x%02X", 
                     g_rxData[0], g_rxData[1]);
            AddLogMessage(logMsg);
        }
        break;

    case UART_CMD_RECEIVE:
        if (g_rxLen >= 3) {
            int8_t rssi = (int8_t)g_rxData[0];
            int8_t snr = (int8_t)g_rxData[1];
            
            // Convert data to string
            char dataStr[256] = {0};
            int dataLen = g_rxLen - 2;
            if (dataLen > 250) dataLen = 250;
            memcpy(dataStr, &g_rxData[2], dataLen);
            dataStr[dataLen] = '\0';

            swprintf(logMsg, 512, L"[RX] RSSI=%d SNR=%d Data: %hs", 
                     rssi, snr, dataStr);
            AddLogMessage(logMsg);
            UpdateStatus(L"Status: Message received");
        }
        break;

    case UART_CMD_GET_PARAM:
        AddLogMessage(L"[PARAM] Received parameters:");
        for (int i = 0; i < g_rxLen; ) {
            uint8_t paramId = g_rxData[i++];
            switch (paramId) {
            case PARAM_FREQUENCY:
                if (i + 4 <= g_rxLen) {
                    uint32_t freq = ((uint32_t)g_rxData[i] << 24) |
                                    ((uint32_t)g_rxData[i+1] << 16) |
                                    ((uint32_t)g_rxData[i+2] << 8) |
                                    g_rxData[i+3];
                    i += 4;
                    swprintf(logMsg, 512, L"  Frequency: %lu Hz", freq);
                    AddLogMessage(logMsg);
                    
                    wchar_t val[32];
                    swprintf(val, 32, L"%lu", freq);
                    SetWindowText(g_hEditFreq, val);
                }
                break;
            case PARAM_TX_POWER:
                if (i + 1 <= g_rxLen) {
                    int8_t power = (int8_t)g_rxData[i++];
                    swprintf(logMsg, 512, L"  TX Power: %d dBm", power);
                    AddLogMessage(logMsg);
                    
                    wchar_t val[32];
                    swprintf(val, 32, L"%d", power);
                    SetWindowText(g_hEditPower, val);
                }
                break;
            case PARAM_SF:
                if (i + 1 <= g_rxLen) {
                    uint8_t sf = g_rxData[i++];
                    swprintf(logMsg, 512, L"  SF: %d", sf);
                    AddLogMessage(logMsg);
                    
                    wchar_t val[32];
                    swprintf(val, 32, L"%d", sf);
                    SetWindowText(g_hEditSF, val);
                }
                break;
            case PARAM_BW:
                if (i + 1 <= g_rxLen) {
                    uint8_t bw = g_rxData[i++];
                    swprintf(logMsg, 512, L"  BW: %d (%s)", bw, 
                             bw < 10 ? BW_Strings[bw] : L"?");
                    AddLogMessage(logMsg);
                    
                    if (bw < 10) {
                        SendMessage(g_hComboBW, CB_SETCURSEL, bw, 0);
                    }
                }
                break;
            case PARAM_CR:
                if (i + 1 <= g_rxLen) {
                    uint8_t cr = g_rxData[i++];
                    swprintf(logMsg, 512, L"  CR: 4/%d", cr + 4);
                    AddLogMessage(logMsg);
                    
                    if (cr >= 1 && cr <= 4) {
                        SendMessage(g_hComboCR, CB_SETCURSEL, cr - 1, 0);
                    }
                }
                break;
            case PARAM_SYNC_WORD:
                if (i + 2 <= g_rxLen) {
                    uint16_t sw = ((uint16_t)g_rxData[i] << 8) | g_rxData[i+1];
                    i += 2;
                    swprintf(logMsg, 512, L"  Sync Word: 0x%04X", sw);
                    AddLogMessage(logMsg);
                }
                break;
            default:
                i++;  // Skip unknown
                break;
            }
        }
        break;

    case UART_CMD_GET_HISTORY:
        if (g_rxLen >= 3) {
            uint8_t index = g_rxData[0];
            int8_t rssi = (int8_t)g_rxData[1];
            
            char dataStr[256] = {0};
            int dataLen = g_rxLen - 2;
            if (dataLen > 250) dataLen = 250;
            memcpy(dataStr, &g_rxData[2], dataLen);
            dataStr[dataLen] = '\0';

            swprintf(logMsg, 512, L"[HIST #%d] RSSI=%d: %hs", 
                     index, rssi, dataStr);
            AddLogMessage(logMsg);
        }
        break;

    default:
        swprintf(logMsg, 512, L"[RX] Unknown CMD=0x%02X LEN=%d", g_rxCmd, g_rxLen);
        AddLogMessage(logMsg);
        break;
    }
}

void ReadSerialData()
{
    if (g_hSerial == INVALID_HANDLE_VALUE) return;

    uint8_t buffer[256];
    DWORD bytesRead = 0;

    if (ReadFile(g_hSerial, buffer, sizeof(buffer), &bytesRead, NULL)) {
        for (DWORD i = 0; i < bytesRead; i++) {
            ProcessReceivedByte(buffer[i]);
        }
    }
}

// ======================== UI Helper Functions ========================

void AddLogMessage(const wchar_t* msg)
{
    // Add timestamp
    SYSTEMTIME st;
    GetLocalTime(&st);
    
    wchar_t fullMsg[600];
    swprintf(fullMsg, 600, L"[%02d:%02d:%02d] %s", 
             st.wHour, st.wMinute, st.wSecond, msg);

    int idx = (int)SendMessage(g_hListRecv, LB_ADDSTRING, 0, (LPARAM)fullMsg);
    SendMessage(g_hListRecv, LB_SETTOPINDEX, idx, 0);
}

void AddLogMessageA(const char* msg)
{
    wchar_t wMsg[512];
    MultiByteToWideChar(CP_ACP, 0, msg, -1, wMsg, 512);
    AddLogMessage(wMsg);
}

void UpdateStatus(const wchar_t* status)
{
    SetWindowText(g_hStaticStatus, status);
}

// ======================== Action Functions ========================

void SendConnect()
{
    // Get selected port
    int sel = (int)SendMessage(g_hComboPort, CB_GETCURSEL, 0, 0);
    if (sel == CB_ERR) {
        MessageBox(g_hWnd, L"Please select a COM port", L"Error", MB_ICONWARNING);
        return;
    }

    wchar_t portName[32];
    SendMessage(g_hComboPort, CB_GETLBTEXT, sel, (LPARAM)portName);

    // Open serial port if not already open
    if (g_hSerial == INVALID_HANDLE_VALUE) {
        if (!OpenSerialPort(portName)) {
            MessageBox(g_hWnd, L"Failed to open serial port", L"Error", MB_ICONERROR);
            return;
        }
        
        wchar_t msg[64];
        swprintf(msg, 64, L"Opened %s at 115200 baud", portName);
        AddLogMessage(msg);
    }

    // Send connect command
    SendPacket(UART_CMD_CONNECT, NULL, 0);
    UpdateStatus(L"Status: Connecting...");
}

void SendDisconnect()
{
    if (g_hSerial == INVALID_HANDLE_VALUE) return;

    SendPacket(UART_CMD_DISCONNECT, NULL, 0);
    
    // Wait a bit then close
    Sleep(100);
    CloseSerialPort();
    
    EnableWindow(g_hBtnConnect, TRUE);
    EnableWindow(g_hBtnDisconnect, FALSE);
    SetWindowText(g_hWnd, L"LoRa Node Host - Disconnected");
    UpdateStatus(L"Status: Disconnected");
    AddLogMessage(L"Serial port closed");
}

void SendLoRaMessage()
{
    if (!g_bConnected) {
        MessageBox(g_hWnd, L"Please connect first", L"Error", MB_ICONWARNING);
        return;
    }

    wchar_t wText[256];
    GetWindowText(g_hEditSend, wText, 256);

    // Convert to ASCII
    char text[256];
    WideCharToMultiByte(CP_ACP, 0, wText, -1, text, 256, NULL, NULL);

    int len = (int)strlen(text);
    if (len == 0) {
        MessageBox(g_hWnd, L"Please enter a message", L"Error", MB_ICONWARNING);
        return;
    }

    if (len > 200) {
        MessageBox(g_hWnd, L"Message too long (max 200 bytes)", L"Error", MB_ICONWARNING);
        return;
    }

    SendPacket(UART_CMD_SEND, (uint8_t*)text, (uint8_t)len);
    
    wchar_t logMsg[300];
    swprintf(logMsg, 300, L"[SEND] %s", wText);
    AddLogMessage(logMsg);

    SetWindowText(g_hEditSend, L"");
    UpdateStatus(L"Status: Message sent");
}

void SetLoRaParams()
{
    if (!g_bConnected) {
        MessageBox(g_hWnd, L"Please connect first", L"Error", MB_ICONWARNING);
        return;
    }

    wchar_t text[64];
    uint8_t data[8];

    // Set Frequency
    GetWindowText(g_hEditFreq, text, 64);
    uint32_t freq = (uint32_t)_wtol(text);
    if (freq > 0) {
        data[0] = PARAM_FREQUENCY;
        data[1] = (freq >> 24) & 0xFF;
        data[2] = (freq >> 16) & 0xFF;
        data[3] = (freq >> 8) & 0xFF;
        data[4] = freq & 0xFF;
        SendPacket(UART_CMD_SET_PARAM, data, 5);
        Sleep(50);
    }

    // Set TX Power
    GetWindowText(g_hEditPower, text, 64);
    int power = _wtoi(text);
    data[0] = PARAM_TX_POWER;
    data[1] = (uint8_t)power;
    SendPacket(UART_CMD_SET_PARAM, data, 2);
    Sleep(50);

    // Set SF
    GetWindowText(g_hEditSF, text, 64);
    int sf = _wtoi(text);
    if (sf >= 5 && sf <= 12) {
        data[0] = PARAM_SF;
        data[1] = (uint8_t)sf;
        SendPacket(UART_CMD_SET_PARAM, data, 2);
        Sleep(50);
    }

    // Set BW
    int bwSel = (int)SendMessage(g_hComboBW, CB_GETCURSEL, 0, 0);
    if (bwSel != CB_ERR) {
        data[0] = PARAM_BW;
        data[1] = (uint8_t)bwSel;
        SendPacket(UART_CMD_SET_PARAM, data, 2);
        Sleep(50);
    }

    // Set CR
    int crSel = (int)SendMessage(g_hComboCR, CB_GETCURSEL, 0, 0);
    if (crSel != CB_ERR) {
        data[0] = PARAM_CR;
        data[1] = (uint8_t)(crSel + 1);
        SendPacket(UART_CMD_SET_PARAM, data, 2);
    }

    AddLogMessage(L"Parameters sent to device");
    UpdateStatus(L"Status: Parameters updated");
}

void GetLoRaParams()
{
    if (!g_bConnected) {
        MessageBox(g_hWnd, L"Please connect first", L"Error", MB_ICONWARNING);
        return;
    }

    SendPacket(UART_CMD_GET_PARAM, NULL, 0);
    UpdateStatus(L"Status: Requesting parameters...");
}

void GetHistory()
{
    if (!g_bConnected) {
        MessageBox(g_hWnd, L"Please connect first", L"Error", MB_ICONWARNING);
        return;
    }

    SendPacket(UART_CMD_GET_HISTORY, NULL, 0);
    UpdateStatus(L"Status: Requesting history...");
}
